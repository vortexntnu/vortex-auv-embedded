#include <samc21j18a.h>
#include "supc.h"
#include <stdint.h>

volatile int8_t bod33_crossed = 0;

void SUPC_Initialize(void) {
    
    // enable bod synch ready interrupt
    SUPC_REGS->SUPC_INTENSET |= SUPC_INTENSET_BVDDSRDY_Msk;

    
    //disable bod while configuring
    SUPC_REGS->SUPC_BODVDD = SUPC_BODVDD_ENABLE(0); 
    while ((SUPC_REGS->SUPC_STATUS & SUPC_STATUS_BVDDSRDY_Msk) != SUPC_STATUS_BVDDSRDY_Msk) {
        ;
    }
    
    //setup config for bod
    SUPC_REGS->SUPC_BODVDD = SUPC_BODVDD_ACTION_INT | 
            SUPC_BODVDD_ACTION(SUPC_BODVDD_ACTION_INT_Val) | 
            SUPC_BODVDD_LEVEL(0x9) | SUPC_BODVDD_ACTCFG(0x0) | 
            SUPC_BODVDD_RUNSTDBY_Msk | SUPC_BODVDD_STDBYCFG(0x0);
    
    //enable bod
    SUPC_REGS->SUPC_BODVDD |= SUPC_BODVDD_ENABLE_Msk;
    while ((SUPC_REGS->SUPC_STATUS & SUPC_STATUS_BVDDSRDY_Msk) != SUPC_STATUS_BVDDSRDY_Msk) {
        ;
    }
    
    
    // enable interrupts for bod detection
    SUPC_REGS->SUPC_INTENSET |= SUPC_INTENSET_BODVDDDET_Msk;
    
    while ((SUPC_REGS->SUPC_STATUS & SUPC_STATUS_BVDDSRDY_Msk) != SUPC_STATUS_BVDDSRDY_Msk) {
        ;
    }
    return;
}

/* 
 * Handler for interrupts generated by crossing BOD33 threshold 
 * Toggles 
 */
void __attribute__((used)) SYSTEM_Handler(void) {
    
    if ((SUPC_REGS->SUPC_INTFLAG & SUPC_INTFLAG_BODVDDDET_Msk) == SUPC_INTFLAG_BODVDDDET_Msk) {
        //PORT_REGS->GROUP[0].PORT_OUTTGL = PORT_PA15;
        PORT_REGS->GROUP[0].PORT_OUTSET |= PORT_PA15;
        bod33_crossed = 1;
    } else {
        PORT_REGS->GROUP[0].PORT_OUTSET = PORT_PA20;
    }
    SUPC_REGS->SUPC_INTFLAG |= SUPC_INTFLAG_BODVDDDET_Msk;
}

